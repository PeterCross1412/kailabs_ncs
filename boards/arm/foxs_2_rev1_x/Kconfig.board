## boards/arm/foxs_2_rev1_x/Kconfig.board
```kconfig
# Copyright (c) 2023 Nordic Semiconductor ASA
# SPDX-License-Identifier: Apache-2.0

config BOARD_FOXS_2_REV1_X
	bool "Foxs 2 rev1_x"
	depends on SOC_NRF52832_QFAA
```

## boards/arm/foxs_2_rev1_x/Kconfig.defconfig
```kconfig
# Copyright (c) 2023 Nordic Semiconductor ASA
# SPDX-License-Identifier: Apache-2.0

if BOARD_FOXS_2_REV1_X

config BOARD
	default "foxs_2_rev1_x"

config BT_CTLR
   default BT

endif
```

## boards/arm/pi_remote_v2/Kconfig.board
```kconfig
# Copyright (c) 2023 Nordic Semiconductor ASA
# SPDX-License-Identifier: Apache-2.0

config BOARD_PI_REMOTE_V2
	bool "Pi Remote v2"
	depends on SOC_NRF52832_QFAA
```

## boards/arm/pi_remote_v2/Kconfig.defconfig
```kconfig
# Copyright (c) 2023 Nordic Semiconductor ASA
# SPDX-License-Identifier: Apache-2.0

if BOARD_PI_REMOTE_V2

config BOARD
	default "pi_remote_v2"

config BT_CTLR
   default BT

endif
```
